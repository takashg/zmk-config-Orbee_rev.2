## config/boards/shields/Orbee/Kconfig.defconfig
```kconfig
if SHIELD_ORBEE_R

config ZMK_KEYBOARD_NAME
    default "Orbee_R"

config ZMK_SPLIT
    default y

config ZMK_SPLIT_ROLE_CENTRAL
    default y

endif

if SHIELD_ORBEE_L

config ZMK_KEYBOARD_NAME
    default "Orbee_L"

config ZMK_SPLIT
    default y

endif
```

## config/boards/shields/Orbee/Kconfig.shield
```kconfig
config SHIELD_ORBEE_R
    def_bool $(shields_list_contains,Orbee_R)

config SHIELD_ORBEE_L
    def_bool $(shields_list_contains,Orbee_L)
```
